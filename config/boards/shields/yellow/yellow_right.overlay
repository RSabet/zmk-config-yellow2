/*
 * Copyright (c) 2020 The ZMK Contributors
 *
 * SPDX-License-Identifier: MIT
 */

#include "yellow.dtsi"

// Offset of 6 because the left side has 6 columns
&default_transform {
    col-offset = <6>;
};

// cols:  100, 024, 022, 020, 017
// cols:   D6,  D5,  D4,  D3,  D2
&kscan0 {
    col-gpios
        = <&pro_micro  7 GPIO_ACTIVE_HIGH>
        , <&pro_micro  6 GPIO_ACTIVE_HIGH>
        , <&pro_micro  5 GPIO_ACTIVE_HIGH>
        , <&pro_micro  4 GPIO_ACTIVE_HIGH>
        , <&pro_micro  3 GPIO_ACTIVE_HIGH>
        , <&pro_micro  8 GPIO_ACTIVE_HIGH>
        ;
};
